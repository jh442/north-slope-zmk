## config/boards/shields/northslope/Kconfig.defconfig
```kconfig
# Copyright (c) 2022 The ZMK Contributors
# SPDX-License-Identifier: MIT

if SHIELD_NORTHSLOPE_DONGLE

config ZMK_KEYBOARD_NAME
    default "NorthSlope"

config ZMK_SPLIT_ROLE_CENTRAL
    default y

config ZMK_USB
    default y

endif

if SHIELD_NORTHSLOPE_LEFT || SHIELD_NORTHSLOPE_RIGHT || SHIELD_NORTHSLOPE_DONGLE

config ZMK_SPLIT
    default y

config ZMK_BLE
    default y
endif
```

## config/boards/shields/northslope/Kconfig.shield
```kconfig
# Copyright (c) 2022 The ZMK Contributors
# SPDX-License-Identifier: MIT

config SHIELD_NORTHSLOPE_LEFT
    def_bool $(shields_list_contains,northslope_left)

config SHIELD_NORTHSLOPE_RIGHT
    def_bool $(shields_list_contains,northslope_right)

config SHIELD_NORTHSLOPE_DONGLE
    def_bool $(shields_list_contains,northslope_dongle)
```

## config/west.yml
```yaml
manifest:
  remotes:
    - name: zmkfirmware
      url-base: https://github.com/zmkfirmware
    # Additional modules containing boards/shields/custom code can be listed here as well
    # See https://docs.zephyrproject.org/3.2.0/develop/west/manifest.html#projects
    - name: carrefinho # added for dongle support
      url-base: https://github.com/carrefinho # added for dongle support
  projects:
    - name: zmk
      remote: zmkfirmware
      revision: main
      import: app/west.yml
    - name: prospector-zmk-module # <---added for dongle support
      remote: carrefinho # <---
      revision: main # <---
  self:
    path: config
```
